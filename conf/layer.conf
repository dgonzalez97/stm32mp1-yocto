## conf/layer.conf
```bitbake
# We have a conf and classes directory, add to BBPATH
BBPATH .= ":${LAYERDIR}"

# We have recipes-* directories, add to BBFILES
BBFILES += "${LAYERDIR}/recipes-*/*/*.bb \
            ${LAYERDIR}/recipes-*/*/*.bbappend"

BBFILE_COLLECTIONS += "meta-david"
BBFILE_PATTERN_meta-david = "^${LAYERDIR}/"
BBFILE_PRIORITY_meta-david = "6"

LAYERDEPENDS_meta-david = "core"
LAYERSERIES_COMPAT_meta-david = "kirkstone scarthgap"
```
